## buildroot/configs/rockpi3a_defconfig
```kconfig
BR2_aarch64=y
BR2_TOOLCHAIN_EXTERNAL=y
BR2_TOOLCHAIN_EXTERNAL_CUSTOM=y
BR2_TOOLCHAIN_EXTERNAL_PATH="$(TOPDIR)/../prebuilts/gcc/linux-x86/aarch64/gcc-linaro-6.3.1-2017.05-x86_64_aarch64-linux-gnu"
BR2_TOOLCHAIN_EXTERNAL_CUSTOM_PREFIX="$(ARCH)-linux-gnu"
BR2_TOOLCHAIN_EXTERNAL_GCC_6=y
BR2_TOOLCHAIN_EXTERNAL_HEADERS_4_6=y
BR2_TOOLCHAIN_EXTERNAL_CUSTOM_GLIBC=y
BR2_TARGET_GENERIC_HOSTNAME="rockpi3a"
BR2_TARGET_GENERIC_ISSUE="Welcome to RK356X Buildroot"
BR2_TARGET_GENERIC_GETTY_PORT="ttyFIQ0"
BR2_TARGET_TZ_INFO=y
BR2_TARGET_TZ_ZONELIST="asia"
BR2_TARGET_LOCALTIME="Asia/Shanghai"
BR2_TARGET_ROOTFS_EXT2=y
BR2_TARGET_ROOTFS_EXT2_4=y
BR2_TARGET_ROOTFS_EXT2_SIZE="64M"
```

## kernel/drivers/net/wireless/rockchip_wlan/mxm_wifiex/Kconfig
```kconfig
config MXM_WIFIEX
	bool "Marvell WiFi-Ex Driver"
	depends on CFG80211 && MMC && PCI && USB
	select FW_LOADER
	select WANT_DEV_COREDUMP
	---help---
	  This adds support for wireless adapters based on Marvell
	  8801/8887/8897/8977/8978/8987/8997/9098/9099/9188 chipsets
	  with SDIO interface, 8897/8997/9097/9098 chipsets with
	  PCIe interface, 8801/8897/8978/8997/9097/9098 chipset
	  with USB interface.
```
