// SPDX-License-Identifier: (GPL-2.0+ OR MIT)
/*
 * Copyright (c) 2020 Rockchip Electronics Co., Ltd.
 * Copyright (c) 2021 Radxa Limited.
 *
 */

/dts-v1/;

#include "rk3566-radxa-rock-3-compute-module.dtsi"

/ {
	model = "Radxa CM3 RPI CM4 IO";
	compatible = "radxa,radxa-cm3-rpi-cm4-io", "rockchip,rk3566";
};

