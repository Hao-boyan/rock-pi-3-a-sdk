// SPDX-License-Identifier: (GPL-2.0+ OR MIT)
/*
 * Copyright (c) 2020 Rockchip Electronics Co., Ltd.
 * Copyright (c) 2021 Radxa Limited.
 *
 */

/dts-v1/;
#include "rk3568-radxa-rock-3-compute-module-plus.dtsi"

/ {
	model = "Radxa E25";
	compatible = "radxa,e25", "rockchip,rk3568";
};
